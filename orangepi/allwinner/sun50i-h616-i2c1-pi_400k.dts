/dts-v1/;

/ {
	compatible = "allwinner,sun50i-h616";

	fragment@0 {
		target = <0xffffffff>;

		__overlay__ {
			pinctrl-names = "default";
			pinctrl-0 = <0xffffffff>;
			status = "okay";
			clock-frequency = <400000>;
		};
	};

	__fixups__ {
		i2c1 = "/fragment@0:target:0";
		i2c1_pi_pins = "/fragment@0/__overlay__:pinctrl-0:0";
	};
};
